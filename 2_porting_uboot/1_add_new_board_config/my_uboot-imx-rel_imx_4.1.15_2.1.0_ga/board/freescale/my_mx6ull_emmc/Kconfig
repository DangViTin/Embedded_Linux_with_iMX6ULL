## 2_porting_uboot/1_add_new_board_config/my_uboot-imx-rel_imx_4.1.15_2.1.0_ga/board/freescale/my_mx6ull_emmc/Kconfig
```kconfig
if TARGET_MY_MX6ULL_EMMC

config SYS_BOARD
	default "my_mx6ull_emmc"

config SYS_VENDOR
	default "freescale"

config SYS_SOC
	default "mx6"

config SYS_CONFIG_NAME
	default "my_mx6ull_emmc"

endif
```

## 2_porting_uboot/1_add_new_board_config/my_uboot-imx-rel_imx_4.1.15_2.1.0_ga/configs/my_mx6ull_emmc_defconfig
```kconfig
CONFIG_SYS_EXTRA_OPTIONS="IMX_CONFIG=board/freescale/my_mx6ull_emmc/imximage.cfg,MX6ULL_EVK_EMMC_REWORK"
CONFIG_ARM=y
CONFIG_ARCH_MX6=y
CONFIG_TARGET_MY_MX6ULL_EMMC=y
CONFIG_CMD_GPIO=y
```
